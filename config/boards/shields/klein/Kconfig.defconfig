## config/boards/shields/klein/Kconfig.defconfig
```kconfig
# Copyright (c) 2023 The ZMK Contributors
# SPDX-License-Identifier: MIT

if SHIELD_KLEIN_LEFT

config ZMK_KEYBOARD_NAME
    default "Klein"
    
config ZMK_SPLIT_ROLE_CENTRAL
    default y

endif

if SHIELD_KLEIN_LEFT || SHIELD_KLEIN_RIGHT

config ZMK_SPLIT
    default y

endif
```

## config/boards/shields/klein/Kconfig.shield
```kconfig
# Copyright (c) 2023 The ZMK Contributors
# SPDX-License-Identifier: MIT

config SHIELD_KLEIN_LEFT
    def_bool $(shields_list_contains,klein_left)

config SHIELD_KLEIN_RIGHT
    def_bool $(shields_list_contains,klein_right)
```
